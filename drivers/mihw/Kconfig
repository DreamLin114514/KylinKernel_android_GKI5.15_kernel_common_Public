## drivers/mihw/Kconfig
```kconfig
# SPDX-License-Identifier: GPL-2.0-only
#
# Xiaomi MI hardware/power helpers (built-in port)
#

config MI_UNION_POWER
	bool "MI UnionPower core: frame load / jank monitor"
	default y
	help
	  Port of Xiaomi's unionpower frame load and jank monitoring engine.
	  Receives frame queue/vsync events from the compositor via
	  /proc/unionpower/ioctl, tracks per-process frame intervals and flags
	  jank. Exposes /sys/.../unionpower/frame_jank. Requires the
	  SurfaceFlinger/compositor side to report frame events to be useful;
	  without reporting it is inert.


config MI_RMAP_EFFICIENCY
        bool "MI rmap efficiency: protect high-mapcount pages"
        default y
        depends on ANDROID_VENDOR_HOOKS
        help
          Skip high-mapcount pages (>= mi_mapcount_thres, default 32) during
          reclaim to reduce CPU load caused by reverse mapping during memory
          reclaim, protecting multi-process-shared pages (GPU/display buffers)
          from being recycled. Faithful port of Xiaomi's mi_rmap_efficiency.
```

## drivers/module/Kconfig
```kconfig
# Kylin Kernel Modules

source "drivers/module/kylin/Kconfig"
source "drivers/module/xiaomi/Kconfig"
source "drivers/module/oplus/Kconfig"
```

## drivers/module/kylin/kylin_used_engine/Kconfig
```kconfig
# Kylin Used Engine

config KYLIN_USED_ENGINE
	bool "Kylin Used Engine: kernel-user tuning/info interface"
	default y
	help
	  Unified kernel<->userspace interface framework.  Features register
	  read-only stat nodes under /proc/kylin_engine/<feature>/ (one bare
	  value per node, easy to parse from userspace C code) and tunable
	  knobs under /sys/kernel/kylin_engine/<feature>/.
	  Built-in only; say Y to build into kernel.
```

## drivers/module/oplus/kshrink_lruvecd/Kconfig
```kconfig
config KSHRINK_LRUVECD
       bool "Support async lruvecd shrink"
       default y
       help
         Asynchronous shrink lruvecd optimization feature.
         Pages whose trylock was contended during vmscan are marked
         and reclaimed later by a dedicated kthread, instead of
         stalling the reclaim path.
         
         This version implements pressure-adaptive behavior:
         - Dynamic queue limits (8/16/32 MiB based on memory pressure)
         - Bounded batch processing to reduce lock contention
         - Pressure-adaptive scheduling and CPU affinity
         - Comprehensive runtime statistics via /proc/kshrink_lruvecd_status
```

## drivers/module/xiaomi/Kconfig
```kconfig
# Xiaomi Modules

config MI_SW_SYNC
        tristate "Mi Software Sync Fence"
        help
          Software sync fence for display frame synchronization.
          Say Y to build into kernel, M for module.

source "drivers/module/xiaomi/kshrink_slabd/Kconfig"
source "drivers/module/xiaomi/lz4asm/Kconfig"
source "drivers/module/xiaomi/vip_sched/Kconfig"
source "drivers/module/xiaomi/touch_boost/Kconfig"

config MI_UNION_POWER
        bool "MI UnionPower core: frame load / jank monitor"
        default y
        help
          Port of Xiaomi's unionpower frame load and jank monitoring engine.
          Receives frame queue/vsync events from the compositor via
          /proc/unionpower/ioctl, tracks per-process frame intervals and flags
          jank. Exposes /sys/.../unionpower/frame_jank. Requires the
          SurfaceFlinger/compositor side to report frame events to be useful;
          without reporting it is inert.


config MI_RMAP_EFFICIENCY
        bool "MI rmap efficiency: protect high-mapcount pages"
        default y
        depends on ANDROID_VENDOR_HOOKS
        help
          Skip high-mapcount pages (>= mi_mapcount_thres, default 32) during
          reclaim to reduce CPU load caused by reverse mapping during memory
          reclaim, protecting multi-process-shared pages (GPU/display buffers)
          from being recycled. Faithful port of Xiaomi's mi_rmap_efficiency.
```

## drivers/module/xiaomi/lz4asm/Kconfig
```kconfig
config LZ4ASM
	tristate "lz4asm support"
	depends on ARM64 && KERNEL_MODE_NEON && CFI_CLANG
	help
	  Enables assembly implementation of LZ4 decompression.
```
